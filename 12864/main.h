#include<reg52.h>
//#include"12864.h"
//#include"pcf8591.h"

/*********************************************************/
#define uchar unsigned char
#define uint  unsigned int
uchar Time0[9],T[5],Data0[5];
uchar code  DIS1[] = {"DATE:"};
uchar code  DIS2[] = {"TIME:"};
uchar code  DIS3[] = {"TEMP:"};
uchar code  DIS4[] = {"AD1:"};
uchar DIS5[]={"°c"};
uchar DIS6[]={"."};
/*#define  PCF8591 0x90    //PCF8591 地址
unsigned char code Disp_Tab[] = {0x30,0x31,0x32,0x33,0x34,0x35,0x36,0x37,0x38,0x39}; 

unsigned char AD_CHANNEL;
unsigned long xdata  LedOut[8];
unsigned int  D[32];
sbit     SCL=P2^3;       //I2C  时钟 
sbit     SDA=P2^4;       //I2C  数据 
bit ack;  
/*******************************************************************
ADC????[??]????               
*******************************************************************/
/*bit ISendByte(unsigned char sla,unsigned char c)
{
   Start_I2c();              //????
   SendByte(sla);            //??????
   if(ack==0)return(0);
   SendByte(c);              //????
   if(ack==0)return(0);
   Stop_I2c();               //????
   return(1);
}
*******************************************************************/
/*bit DACconversion(unsigned char sla,unsigned char c,  unsigned char Val)
{
   Start_I2c();              //启动总线
   SendByte(sla);            //发送器件地址
   if(ack==0)return(0);
   SendByte(c);              //发送控制字节
   if(ack==0)return(0);
   SendByte(Val);            //发送DAC的数值  
   if(ack==0)return(0);
   Stop_I2c();               //结束总线
   return(1);
}

/*******************************************************************
ADC发送字节[命令]数据函数               
*******************************************************************/
/*bit ISendByte(unsigned char sla,unsigned char c)
{
   Start_I2c();              //启动总线
   SendByte(sla);            //发送器件地址
   if(ack==0)return(0);
   SendByte(c);              //发送数据
   if(ack==0)return(0);
   Stop_I2c();               //结束总线
   return(1);
}
unsigned char IRcvByte(unsigned char sla);
*/
unsigned char code Seg_Data[]={	 //the information is showed in the digital tube,shows 0-F//共阳数码管的编码，并将数据定义在CODE区 
					        0xc0,/*0*/
					        0xF9,/*1*/
					        0xA4,/*2*/
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					        0x90,/*9*/				  
							};
unsigned char checkday()                  //自动检查是否是闰年，并为对应的月份设置天数
{
	unsigned char day;
	unsigned int year;
	year=Time0[7]/16*1000+Time0[7]%16*100+Time0[6]/16*10+Time0[6]%16;
	
  if(((year%4==0)&&(year%100==0))||(year%400==0))//判断是否是闰年
 {
	  switch(Time0[4])
	{
		case 0x01: day=0x31;break;
		case 0x02: day=0x29;break;
		case 0x03: day=0x31;break;
		case 0x04: day=0x30;break;
		case 0x05: day=0x31;break;
		case 0x06: day=0x30;break;
		case 0x07: day=0x31;break;
		case 0x08: day=0x31;break;
		case 0x09: day=0x30;break;
		case 0x10: day=0x31;break;
		case 0x11: day=0x30;break;
		case 0x12: day=0x31;break;
	}
 }
 else
 {
 switch(Time0[4])
	{
		case 0x01: day=0x31;break;
		case 0x02: day=0x28;break;
		case 0x03: day=0x31;break;
		case 0x04: day=0x30;break;
		case 0x05: day=0x31;break;
		case 0x06: day=0x30;break;
		case 0x07: day=0x31;break;
		case 0x08: day=0x31;break;
		case 0x09: day=0x30;break;
		case 0x10: day=0x31;break;
		case 0x11: day=0x30;break;
		case 0x12: day=0x31;break;
	}
	}
 
 return(day);
}



unsigned char Time0[9],week[3],week0,DisplayData[8], Data0[5];
void readtime();
void Lcd12864Display();
void ClockPlay();
void timesetting();
void year(unsigned char k);//年加减
void month(unsigned char k);//月加减
void day(unsigned char k);
void hour(unsigned char k);
void min(unsigned char k);
void sec(unsigned char k);
void delay0(unsigned int n);

void LcdDisplayTemp0(int temp);
void delay2(unsigned int n)
{
	while(n--);
}
unsigned char keyboardscan()
{
	unsigned char board_h, board_l;
	P1=0x0f;
	board_h=P1&0x0f;
	if(board_h!=0x0f)
	{
		delay2(5000);
		board_h=P1&0x0f;
		if(board_h!=0x0f)
		{
			P1=board_h|0xf0;
			board_l=P1&0xf0;
			return(board_h+board_l);
		}
	}
	return(0xff);
}

/*********************************************************/
uchar code Photo1[] ={
      0x00,0x00,0x00,0x04,0x00,0x00,0x00,0x00,
      0x00,0x00,0x00,0x00,0x00,0x00,0x00,0x00,
      0x00,0x00,0x00,0x00,0x00,0x00,0x00,0x00,
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      0x00,0x00,0x00,0x00,0x00,0x00,0x00,0x00
};
/******************************************************************************/
uchar code Photo2[] ={
/*--  调入了一幅图像：C:\Users\Administrator\Desktop\资料\自动化.bmp  --*/
/*--  宽度x高度=128x64  --*/
0x01,0xFF,0xFF,0xFF,0xFF,0xFF,0xFF,0xFF,0xFF,0xFF,0xFF,0xFF,0xFF,0xFF,0xFF,0x00,
0x07,0xFF,0xFF,0xFF,0xFF,0xFF,0xFF,0xFF,0xFF,0xFF,0xFF,0xFF,0xFF,0xFF,0xFF,0xE0,
0x1F,0xFF,0xFF,0xFF,0xFF,0xFF,0xFF,0xFF,0xFF,0xFF,0xFF,0xFF,0xFF,0xFF,0xFF,0xF0,
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0x00,0x7F,0xFF,0xFF,0xFF,0xFF,0xFF,0xFF,0xFF,0xFF,0xFF,0xFF,0xFF,0xFF,0xFE,0x00

};