/****************************************Copyright (c)****************************************************
**                               Guangzhou ZHIYUAN electronics Co.,LTD.
**                                     
**                                 http://www.embedtools.com
**
**--------------File Info---------------------------------------------------------------------------------
** File Name:                LCD_4_4.c
** Last modified Date:       2010-03-04
** Last Version:             
** Description:              功能：4*4键盘的读取
**                      
** 
**--------------------------------------------------------------------------------------------------------
** Created By:               He Zengfu
** Created date:             2010-06-22
** Version:                  V1.0
** Descriptions: 
**
**--------------------------------------------------------------------------------------------------------
** Modified by:
** Modified date:
** Version:
** Description:
**
*********************************************************************************************************/
/*********************************************************************************************************
**包含的头文件
*********************************************************************************************************/
#include <reg52.h>
#include <string.h>
#include <math.h>
/*********************************************************************************************************
**变量定义
*********************************************************************************************************/
unsigned char fun=1;
unsigned char code day_table[]={31,28,31,30,31,30,31,31,30,31,30,31};
char hour=11;//用有符号char型
char min=15;
char sec=25;
unsigned int   ms=0;
char year=10;
char month=12;
char day=25;
unsigned char buf[]={1,2,3,4,5,6,7,8,1,2,3,4,5,6,7,8,1,2,3,4,5,6};

/********************************************************************************************************
**外部函数声明
********************************************************************************************************/
 extern void delay(long dly);
 extern void write_str(unsigned char x,  unsigned char y,unsigned char *str);
// extern void BELL_ON(int Time);
/*********************************************************************************************
函数名：走时间程序
调  用：NONE
参  数：无
返回值：
结  果：
备  注：在主函数中不断调用
/**********************************************************************************************/
void time1()
{
	ms++;//
	if(ms>999)
	{
		ms=0;
		sec++;
		if(sec>59)
		{
			sec=0;
			min++;
			if(min>59)
			{
				min=0;
				hour++;
				if(hour>23)
				{
					hour=0;
					day++;
					if(day>day_table[month-1])
					{
						day=0;
						year++;
						if(year>99)
						{
							year=0;
						}
					}
				}
			}
		}
	}
}
/*********************************************************************************************************
 ** Function name:     get_date
 ** Descriptions:       
 ** input parameters:    NONE
 **
 ** output parameters:   NONE
 ** Returned value:      NONE
 *********************************************************************************************************/
void get_data()
{
    unsigned char code hz[]={"日期年月日"};//
	buf[0]=hz[0];
	buf[1]=hz[1];
	buf[2]=hz[2]; 
	buf[3]=hz[3];
	buf[4]=':';
	buf[5]=' ';
	buf[6]='2';
	buf[7]='0';
	buf[8]=year/10+0x30;  
	buf[9]=year%10+0x30;
	buf[10]=hz[4];	
	buf[11]=hz[5];																																																																																																																																															   	   	   	   																																												
	buf[12]=month/10+0x30;
	buf[13]=month%10+0x30;
	buf[14]=hz[6];
	buf[15]=hz[7];
	buf[16]=day/10+0x30;
	buf[17]=day%10+0x30;
	buf[18]=hz[8];
	buf[19]=hz[9];
    buf[20]=0x00;//

		
}
/*********************************************************************************************************
 ** Function name:      get_time
 ** Descriptions:        
 ** input parameters:    NONE
 **
 ** output parameters:   NONE
 ** Returned value:      NONE
 *********************************************************************************************************/
void get_time()
{
	
    unsigned char code hz[]={"时间时分秒"};
	buf[0]=hz[0];
	buf[1]=hz[1];
	buf[2]=hz[2];  
	buf[3]=hz[3];
	buf[4]=':';
	buf[5]=' ';
	buf[6]=' ';
	buf[7]=' ';
	buf[8]=hour/10+0x30;  
	buf[9]=hour%10+0x30;
	buf[10]=hz[4];
	buf[11]=hz[5];
	buf[12]=min/10+0x30;
	buf[13]=min%10+0x30;
	buf[14]=hz[6];
	buf[15]=hz[7];
	buf[16]=sec/10+0x30;
	buf[17]=sec%10+0x30;
	buf[18]=hz[8];
	buf[19]=hz[9];
    buf[20]=0x00;
	
}/*********************************************************************************************************
 ** Function name:    display1
 ** Descriptions:        
 ** input parameters:    NONE
 **
 ** output parameters:   NONE
 ** Returned value:      NONE
 *********************************************************************************************************/
void display1(void)
{
	 write_str(0,16,buf);
}
/*********************************************************************************************************
 ** Function name:      display2
 ** Descriptions:        
 ** input parameters:    NONE
 **
 ** output parameters:   NONE
 ** Returned value:      NONE
 *********************************************************************************************************/
void display2(void)
{
	write_str(0,32,buf);
}
